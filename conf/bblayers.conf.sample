## scripts/lib/image/canned-wks/sdimage-gumstix.wks
```
# short-description: Create SD card image with a boot partition
# long-description: Creates a partitioned SD card image. Boot files
# are located in the first vfat partition.

part /boot --source bootimg-partition --ondisk mmcblk0 --fstype=vfat --label boot --active --align 64 --size 16

part / --source rootfs --ondisk mmcblk0 --fstype=ext4 --label root --align 8192 --size 1024

part swap --ondisk mmcblk0 --size 512 --label swap1 --fstype=swap
```
