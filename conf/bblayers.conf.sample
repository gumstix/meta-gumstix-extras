## conf/bblayers.conf.sample
```bitbake
# LAYER_CONF_VERSION is increased each time build/conf/bblayers.conf
# changes incompatibly
LCONF_VERSION = "6"

BBPATH = "${TOPDIR}"
BBFILES ?= ""
BBLAYERS ?= " \
  ##COREBASE##/meta \
  ##COREBASE##/meta-poky \
  ##COREBASE##/meta-openembedded/meta-gnome \
  ##COREBASE##/meta-openembedded/meta-oe \
  ##COREBASE##/meta-openembedded/meta-xfce \
  ##COREBASE##/meta-openembedded/meta-networking \
  ##COREBASE##/meta-openembedded/meta-multimedia \
  ##COREBASE##/meta-openembedded/meta-python \
  ##COREBASE##/meta-openembedded/meta-webserver \
  ##COREBASE##/meta-gumstix \
  ##COREBASE##/meta-gumstix-extras \
  ##COREBASE##/meta-ti \
  ##COREBASE##/meta-qt5 \
  ##COREBASE##/meta-raspberrypi \
  ##COREBASE##/meta-tegra \
  ##COREBASE##/meta-tegra/contrib \
  ##COREBASE##/meta-java \
  ##COREBASE##/meta-browser \
  ##COREBASE##/meta-clang \
  ##COREBASE##/meta-python2 \
  ##COREBASE##/meta-arm/meta-arm \
  ##COREBASE##/meta-arm/meta-arm-toolchain \
  "

BBMASK = "meta-ti/recipes-kernel \
"
```

## conf/layer.conf
```bitbake
# We have a conf directory, append to BBPATH
BBPATH .= ":${LAYERDIR}"

# We have a recipes directory, add to BBFILES
BBFILES += "${LAYERDIR}/recipes-*/*/*.bb \
            ${LAYERDIR}/recipes-*/*/*.bbappend"

BBFILE_COLLECTIONS += "meta-gumstix-extras"
BBFILE_PATTERN_meta-gumstix-extras := "^${LAYERDIR}/"
BBFILE_PRIORITY_meta-gumstix-extras = "8"

LAYERSERIES_COMPAT_meta-gumstix-extras = "warrior"
```
